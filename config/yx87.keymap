/*
 * yx87 minimal keymap
 * DIAG 1x1 matrix (1 row x 1 col), single A key
 */

#include <behaviors.dtsi>
#include <dt-bindings/zmk/keys.h>

/ {
    keymap {
        compatible = "zmk,keymap";

        default_layer {
            bindings = <
    &kp A
            >;
        };
    };
};
