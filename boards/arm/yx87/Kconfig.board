## boards/arm/yx87/Kconfig.board
```kconfig
# yx87 board configuration

config BOARD_YX87
    bool "yx87"
    depends on SOC_NRF52840_QIAA
```

## boards/arm/yx87/Kconfig.defconfig
```kconfig
if BOARD_YX87

config BOARD
    default "yx87"

if USB_DEVICE_STACK

config USB_NRFX
    default y

endif # USB_DEVICE_STACK

config BT_CTLR
    default BT

endif # BOARD_YX87
```
